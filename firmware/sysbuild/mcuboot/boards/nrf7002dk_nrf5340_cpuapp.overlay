/*
 * Copyright (c) 2026 Nordic Semiconductor ASA
 *
 * SPDX-License-Identifier: LicenseRef-Nordic-5-Clause
 */

/delete-node/ &slot1_partition;

#include "../../../../mvp_firmware/boards/mcuboot-image-slots.dtsi"

/ {
	chosen {
		zephyr,code-partition = &boot_partition;
	};
};
