## CMakeLists.txt
```
cmake_minimum_required(VERSION 3.20.0)
find_package(Zephyr REQUIRED HINTS $ENV{ZEPHYR_BASE})
project(dryspool_ble)
set(mvp "${CMAKE_CURRENT_SOURCE_DIR}/../mvp_firmware/src")
target_include_directories(app PRIVATE "${mvp}")
target_sources(app PRIVATE src/radio.c)
if(CONFIG_DRYSPOOL_NODE)
  zephyr_include_directories("../firmware/config")
  target_link_libraries(app INTERFACE "-Wl,--require-defined=g_memfault_build_id")
  target_sources(app PRIVATE src/node_fleet.c src/node.c "${mvp}/main.c" "${mvp}/bme280.c" "${mvp}/fan.c"
    "${mvp}/nau7802.c" "${mvp}/calibration.c" "${mvp}/profile.c" "${mvp}/readings.c" "${mvp}/commands.c")
else()
  # The nRF70 driver consumes the original radio patch header. It is a
  # fixed factory component on SPI NOR, outside the signed app's DFU slots.
  dt_nodelabel(patch_node NODELABEL nrf70_wifi_fw_partition REQUIRED)
  dt_nodelabel(qspi_node NODELABEL qspi REQUIRED)
  dt_reg_addr(patch_offset PATH "${patch_node}")
  dt_reg_addr(ext_flash_base PATH "${qspi_node}" NAME qspi_mm)
  math(EXPR patch_address "${ext_flash_base} + ${patch_offset}")
  set(patch_bin "${ZEPHYR_NRFXLIB_MODULE_DIR}/nrf_wifi/bin/ncs/default/nrf70.bin")
  add_custom_command(OUTPUT "${CMAKE_BINARY_DIR}/nrf70.hex"
    COMMAND ${Python3_EXECUTABLE} -c
      "import sys,intelhex; sys.exit(intelhex.bin2hex(sys.argv[1], sys.argv[2], int(sys.argv[3])))"
      "${patch_bin}" "${CMAKE_BINARY_DIR}/nrf70.hex" "${patch_address}"
    DEPENDS "${patch_bin}" VERBATIM)
  add_custom_target(gateway_wifi_patch ALL DEPENDS "${CMAKE_BINARY_DIR}/nrf70.hex")
  target_sources(app PRIVATE src/gateway.c src/web.c src/cloud_shadow.c src/box_relay.c)
  zephyr_include_directories(config)
  target_link_libraries(app INTERFACE "-Wl,--require-defined=g_memfault_build_id")
  zephyr_linker_sources(SECTIONS sections.ld)
  zephyr_linker_section(NAME http_resource_desc_gateway_http KVMA RAM_REGION GROUP RODATA_REGION)
  generate_inc_file_for_target(app "${CMAKE_CURRENT_SOURCE_DIR}/web/index.html"
    "${ZEPHYR_BINARY_DIR}/include/generated/dryspool_page.inc" --gzip)
endif()
```

## Kconfig
```
mainmenu "DrySpool Bluetooth"
config DRYSPOOL_NODE
	bool "Build a sensor box instead of a gateway"
rsource "../firmware/Kconfig"
```

## Kconfig.sysbuild
```
config PARTITION_MANAGER
	default n if !BOARD_IS_NON_SECURE
config NRF_DEFAULT_IPC_RADIO
	default y
config NETCORE_IPC_RADIO_BT_HCI_IPC
	default y
config WIFI_NRF70
	default y if BOARD_NRF7002DK_NRF5340_CPUAPP_NS

source "share/sysbuild/Kconfig"
```

## sysbuild.conf
```
# Use the key already trusted by the deployed DrySpool bootloader.
SB_CONFIG_BOOT_SIGNATURE_TYPE_ECDSA_P256=y
SB_CONFIG_BOOT_SIGNATURE_KEY_FILE="\${APPLICATION_CONFIG_DIR}/../firmware/keys/dryspool-signing.pem"
SB_CONFIG_BOOTLOADER_MCUBOOT=y
```

## prj.conf
```kconfig
CONFIG_BT=y
CONFIG_BT_PERIPHERAL=y
CONFIG_BT_CENTRAL=y
CONFIG_BT_GATT_CLIENT=y
CONFIG_BT_SMP=y
CONFIG_BT_SMP_APP_PAIRING_ACCEPT=y
CONFIG_BT_MAX_CONN=3
CONFIG_BT_MAX_PAIRED=3
CONFIG_BT_DEVICE_NAME="DrySpool Gateway"
CONFIG_BT_SETTINGS=y
CONFIG_SETTINGS=y
CONFIG_FLASH=y
CONFIG_FLASH_MAP=y
CONFIG_NVS=y
CONFIG_SETTINGS_NVS=y
CONFIG_GPIO=y
CONFIG_LOG=y
CONFIG_MAIN_STACK_SIZE=4096
CONFIG_SYSTEM_WORKQUEUE_STACK_SIZE=2048
```

## gateway.conf
```kconfig
# Local IPv4 dashboard and the nRF7002 station.
CONFIG_NETWORKING=y
CONFIG_NET_IPV4=y
CONFIG_NET_IPV6=n
CONFIG_NET_TCP=y
CONFIG_NET_DHCPV4=y
CONFIG_DNS_RESOLVER=y
CONFIG_NET_SOCKETS=y
CONFIG_NET_SOCKETS_OFFLOAD=n
CONFIG_NET_SOCKETS_SOCKOPT_TLS=y
CONFIG_NET_CONNECTION_MANAGER=y
CONFIG_NET_MGMT_EVENT_QUEUE_SIZE=30
CONFIG_NET_L2_ETHERNET=y
CONFIG_WIFI=y
CONFIG_WIFI_NRF70=y
CONFIG_NRF_WIFI_PATCHES_EXT_FLASH_STORE=y
CONFIG_SPI_NOR_SFDP_DEVICETREE=y
CONFIG_SPI_NOR_FLASH_LAYOUT_PAGE_SIZE=4096
CONFIG_WIFI_NRF70_SKIP_LOCAL_ADMIN_MAC=y
CONFIG_WIFI_NM_WPA_SUPPLICANT=y
CONFIG_L2_WIFI_CONNECTIVITY=y
CONFIG_WIFI_CREDENTIALS=y
CONFIG_SHELL=y
CONFIG_NET_L2_WIFI_SHELL=y
CONFIG_WIFI_CREDENTIALS_SHELL=y
CONFIG_SHELL_STACK_SIZE=6144
CONFIG_NET_MGMT_EVENT_STACK_SIZE=4096
CONFIG_WIFI_NM_WPA_SUPPLICANT_THREAD_STACK_SIZE=6144
CONFIG_NRF_WIFI_CTRL_HEAP_SIZE=20000
CONFIG_NRF_WIFI_DATA_HEAP_SIZE=92856
CONFIG_HEAP_MEM_POOL_SIZE=40144
CONFIG_HEAP_MEM_POOL_IGNORE_MIN=y
CONFIG_NET_MAX_CONN=8
CONFIG_NET_MAX_CONTEXTS=8
CONFIG_NET_TX_STACK_SIZE=1024
CONFIG_NET_RX_STACK_SIZE=2048
CONFIG_NET_CONTEXT_SNDTIMEO=y
CONFIG_POSIX_API=y
CONFIG_BT_PERIPHERAL=n
CONFIG_BT_MAX_CONN=2
CONFIG_BT_MAX_PAIRED=2
CONFIG_NRF70_SR_COEX=y
CONFIG_NRF70_SR_COEX_RF_SWITCH=y
CONFIG_MPSL_CX=y
CONFIG_HTTP_SERVER=y
CONFIG_HTTP_SERVER_CAPTURE_HEADERS=y
CONFIG_HTTP_SERVER_CAPTURE_HEADER_COUNT=4
CONFIG_HTTP_SERVER_CAPTURE_HEADER_BUFFER_SIZE=256
CONFIG_HTTP_SERVER_MAX_CLIENTS=2
CONFIG_HTTP_SERVER_CLIENT_BUFFER_SIZE=1024
CONFIG_JSON_LIBRARY=y
CONFIG_PICOLIBC_IO_FLOAT=y
CONFIG_MAIN_STACK_SIZE=4096
CONFIG_SYSTEM_WORKQUEUE_STACK_SIZE=4096
CONFIG_LTO=y
CONFIG_ISR_TABLES_LOCAL_DECLARATION=y

# Memfault HTTPS heartbeat metrics, diagnostics and signed release management.
CONFIG_BUILD_WITH_TFM=y
CONFIG_TFM_PARTITION_PROTECTED_STORAGE=y
CONFIG_TFM_PROFILE_TYPE_NOT_SET=y
CONFIG_TFM_PSA_FRAMEWORK_HAS_MM_IOVEC=y
CONFIG_TFM_CRYPTO_ASYM_SIGN_MODULE_ENABLED=y
CONFIG_MBEDTLS=y
CONFIG_MBEDTLS_ENABLE_HEAP=y
CONFIG_MBEDTLS_CIPHERSUITE_TLS_ECDHE_RSA_WITH_AES_128_CBC_SHA256=y
CONFIG_MBEDTLS_PEM_PARSE_C=y
CONFIG_PSA_WANT_ALG_ECDSA=y
CONFIG_TLS_MAX_CREDENTIALS_NUMBER=8
CONFIG_MBEDTLS_HEAP_SIZE=49152
CONFIG_MBEDTLS_SSL_SERVER_NAME_INDICATION=y
CONFIG_MBEDTLS_SSL_IN_CONTENT_LEN=4096
CONFIG_MBEDTLS_SSL_OUT_CONTENT_LEN=4096
CONFIG_MBEDTLS_SSL_MAX_FRAGMENT_LENGTH=y
CONFIG_PSA_WANT_ALG_PBKDF2_HMAC=y
CONFIG_PSA_WANT_ALG_PBKDF2_AES_CMAC_PRF_128=y
CONFIG_MEMFAULT=y
CONFIG_MEMFAULT_HTTP_ENABLE=y
CONFIG_MEMFAULT_NCS_DEVICE_ID_HW_ID=y
CONFIG_HW_ID_LIBRARY_SOURCE_DEVICE_ID=y
CONFIG_MEMFAULT_NCS_FW_VERSION_STATIC=y
CONFIG_MEMFAULT_NCS_FW_TYPE="dryspool-gateway"
CONFIG_MEMFAULT_NCS_HW_VERSION="nrf7002dk-rev1"
CONFIG_MEMFAULT_NCS_PROJECT_KEY=""
CONFIG_MEMFAULT_ROOT_CERT_STORAGE_TLS_CREDENTIAL_STORAGE=y
CONFIG_MEMFAULT_NCS_PROVISION_CERTIFICATES=y
CONFIG_MEMFAULT_NCS_INTERNAL_FLASH_BACKED_COREDUMP=y
CONFIG_MEMFAULT_PERIODIC_UPLOAD=y
CONFIG_MEMFAULT_PERIODIC_UPLOAD_ENABLED_DEFAULT=y
CONFIG_MEMFAULT_PERIODIC_UPLOAD_USE_DEDICATED_WORKQUEUE=y
CONFIG_MEMFAULT_METRICS_HEARTBEAT_INTERVAL_SECS=300
CONFIG_MEMFAULT_PERIODIC_UPLOAD_INTERVAL_SECS=300
CONFIG_MEMFAULT_METRICS_MEMORY_USAGE=n
CONFIG_MEMFAULT_SHELL=y
CONFIG_MEMFAULT_FAULT_HANDLER_RETURN=y
CONFIG_MEMFAULT_PERIODIC_FOTA_CHECK=y
CONFIG_FOTA_DOWNLOAD=y
CONFIG_DFU_TARGET=y
CONFIG_DOWNLOADER=y
CONFIG_IMG_MANAGER=y
CONFIG_STREAM_FLASH=y
CONFIG_IMG_ERASE_PROGRESSIVELY=y
CONFIG_REBOOT=y
CONFIG_DOWNLOADER_MAX_FILENAME_SIZE=400
CONFIG_DOWNLOADER_STACK_SIZE=8192

# G owns its own nRF Cloud device identity. Its Shadow uses CoAP/DTLS
# alongside the HTTPS connection for Memfault Release Management.
CONFIG_NRF_CLOUD=y
CONFIG_NRF_CLOUD_COAP=y
CONFIG_NRF_CLOUD_JWT_SOURCE_CUSTOM=y
CONFIG_NRF_CLOUD_CLIENT_ID_SRC_HW_ID=y
CONFIG_DATE_TIME=y
CONFIG_DATE_TIME_RETRY_COUNT=5
CONFIG_DATE_TIME_RETRY_INTERVAL_SECONDS=20
CONFIG_MBEDTLS_DTLS=y
CONFIG_MBEDTLS_SSL_COOKIE_C=y
CONFIG_MBEDTLS_CIPHERSUITE_TLS_ECDHE_ECDSA_WITH_AES_128_GCM_SHA256=y
CONFIG_MBEDTLS_SSL_DTLS_HELLO_VERIFY=y
CONFIG_MBEDTLS_SSL_DTLS_CONNECTION_ID=y
CONFIG_NET_SOCKETS_ENABLE_DTLS=y
CONFIG_NET_SOCKETS_TLS_MAX_CONTEXTS=2
CONFIG_NET_SOCKETS_TLS_MAX_SESSION_CONTEXTS=2
CONFIG_COAP_CLIENT_BLOCK_SIZE=1024
CONFIG_COAP_CLIENT_STACK_SIZE=6144
CONFIG_NRF_CLOUD_COAP_MAX_USER_OPTIONS=0
CONFIG_COAP_CLIENT_MAX_EXTRA_OPTIONS=3
CONFIG_TLS_CREDENTIALS_BACKEND_PROTECTED_STORAGE=y
CONFIG_TLS_CREDENTIALS_SHELL=y
CONFIG_TLS_CREDENTIALS_SHELL_CRED_BUF_SIZE=3072
CONFIG_BASE64=y
CONFIG_SIZE_OPTIMIZATIONS_AGGRESSIVE=y
CONFIG_LOG_MAX_LEVEL=2
```

## node-b.conf
```kconfig
CONFIG_BT_DEVICE_NAME="DrySpool B"
CONFIG_MEMFAULT_NCS_HW_VERSION="dryspool-box-b"
CONFIG_MEMFAULT_NCS_FW_TYPE="dryspool-box-b"
CONFIG_MCUBOOT_EXTRA_IMGTOOL_ARGS="--custom-tlv 0x00a0 dryspool-box-b"
```

## node.conf
```kconfig
CONFIG_DRYSPOOL_NODE=y
CONFIG_I2C=y
CONFIG_SENSOR=y
CONFIG_BME280=y
CONFIG_SHELL=y
CONFIG_BT_DEVICE_NAME="DrySpool A"
CONFIG_BT_CENTRAL=n
CONFIG_BT_GATT_CLIENT=n
CONFIG_IMG_MANAGER=y
CONFIG_NET_BUF=y
CONFIG_ZCBOR=y
CONFIG_CRC=y
CONFIG_MCUMGR=y
CONFIG_MCUMGR_GRP_IMG=y
CONFIG_MCUMGR_GRP_OS=y
CONFIG_MCUMGR_TRANSPORT_BT=y
CONFIG_MCUMGR_TRANSPORT_BT_PERM_RW_ENCRYPT=y
CONFIG_MCUMGR_TRANSPORT_BT_REASSEMBLY=y
CONFIG_MCUMGR_TRANSPORT_WORKQUEUE_STACK_SIZE=3072
CONFIG_STREAM_FLASH=y
CONFIG_FLASH_PAGE_LAYOUT=y
CONFIG_FLASH=y
CONFIG_NORDIC_QSPI_NOR=y

# A and B report their own identities and heartbeat metrics through G.
CONFIG_MEMFAULT=y
CONFIG_MEMFAULT_NCS_DEVICE_ID_HW_ID=y
CONFIG_HW_ID_LIBRARY_SOURCE_DEVICE_ID=y
CONFIG_MEMFAULT_NCS_FW_VERSION_STATIC=y
CONFIG_MEMFAULT_NCS_HW_VERSION="dryspool-box-a"
CONFIG_MEMFAULT_NCS_FW_TYPE="dryspool-box-a"
CONFIG_MEMFAULT_NCS_IMPLEMENT_METRICS_COLLECTION=n
CONFIG_MEMFAULT_METRICS_HEARTBEAT_INTERVAL_SECS=300
CONFIG_MEMFAULT_MCUMGR_GRP=y
CONFIG_MEMFAULT_SHELL=y
CONFIG_REBOOT=y
CONFIG_MCUMGR_GRP_IMG_VERSION_CMP_USE_BUILD_NUMBER=y
CONFIG_IMG_ERASE_PROGRESSIVELY=y
CONFIG_MCUBOOT_EXTRA_IMGTOOL_ARGS="--custom-tlv 0x00a0 dryspool-box-a"
```

## boards/nrf7002dk_nrf5340_cpuapp.overlay
```dts
#include "../../mvp_firmware/boards/nrf7002dk_nrf5340_cpuapp.overlay"
/delete-node/ &slot1_partition;
&slot0_partition { reg = <0x10000 DT_SIZE_K(896)>; };
&mx25r64 {
	partitions {
		compatible = "fixed-partitions";
		#address-cells = <1>;
		#size-cells = <1>;
		slot1_partition: partition@0 {
			label = "image-1";
			reg = <0 DT_SIZE_K(896)>;
		};
	};
};
```

## boards/nrf7002dk_nrf5340_cpuapp_ns.overlay
```dts
#include "../../firmware/boards/nrf7002dk_nrf5340_cpuapp_ns.overlay"

/* MCUboot slot 1 occupies 0..0xe0000. Store the version-matched NCS
 * Wi-Fi microcode separately, so replacing slot 1 cannot erase it. */
&mx25r64 {
	partitions {
		nrf70_wifi_fw_partition: nrf70_fw_partition: partition@100000 {
			label = "nrf70-firmware";
			reg = <0x100000 DT_SIZE_K(128)>;
		};
	};
};
```

## src/box_fleet_wire.h
```c
#pragma once

#include "protocol.h"

#define DS_FLEET_INFO  DS_UUID(2)
#define DS_FLEET_CHUNK DS_UUID(3)
#define DS_FLEET_SVC   DS_UUID(4)
#define DS_CHUNK_MAX   192

/* Fixed length fields include their terminators. A long ATT read retrieves
 * the full record even when the peer uses the minimum MTU. */
struct box_fleet_info {
	char serial[33];
	char hardware[24];
	char software[24];
	char version[32];
	uint8_t confirmed;
};
```

## src/box_image.h
```c
#pragma once

#include <stdbool.h>
#include <stdint.h>
#include <stddef.h>
#include <string.h>

/* MCUboot signed protected TLV 0x00a0 identifies the hardware role. Validate
 * it before selecting slot 1 for a trial, even for a mislabelled cloud release.
 * A bounded protected area is sufficient for the two team-signed payloads. */
struct box_image_identity {
	size_t start;
	size_t length;
	size_t copied;
	uint8_t tlvs[256];
};

static inline uint16_t image_le16(const uint8_t *p)
{
	return (uint16_t)p[0] | ((uint16_t)p[1] << 8);
}

static inline uint32_t image_le32(const uint8_t *p)
{
	return (uint32_t)image_le16(p) | ((uint32_t)image_le16(p + 2) << 16);
}

static inline bool box_image_observe(struct box_image_identity *id, const uint8_t *data,
				     size_t size, size_t offset, size_t total)
{
	if (!offset) {
		if (size < 32 || image_le32(data) != 0x96f3b83dU) {
			return false;
		}
		size_t hdr = image_le16(data + 8);
		size_t body = image_le32(data + 12);
		size_t prot = image_le16(data + 10);
		if (hdr < 32 || hdr > total || body > total - hdr || prot < 4 ||
		    prot > sizeof(id->tlvs) || prot > total - hdr - body) {
			return false;
		}
		*id = (struct box_image_identity){.start = hdr + body, .length = prot};
	}
	size_t start = id->start + id->copied;
	if (start >= offset && start - offset < size && id->copied < id->length) {
		size_t n = size - (start - offset);
		if (n > id->length - id->copied) {
			n = id->length - id->copied;
		}
		memcpy(id->tlvs + id->copied, data + (start - offset), n);
		id->copied += n;
	}
	return true;
}

static inline bool box_image_matches(const struct box_image_identity *id, const char *role)
{
	if (!id->length || id->copied != id->length || image_le16(id->tlvs) != 0x6908 ||
	    image_le16(id->tlvs + 2) != id->length) {
		return false;
	}
	size_t offset = 4;
	bool found = false;
	while (id->length - offset >= 4) {
		uint16_t type = image_le16(id->tlvs + offset);
		size_t size = image_le16(id->tlvs + offset + 2);
		offset += 4;
		if (size > id->length - offset) {
			return false;
		}
		if (type == 0x00a0) {
			if (found || size != strlen(role) ||
			    memcmp(id->tlvs + offset, role, size)) {
				return false;
			}
			found = true;
		}
		offset += size;
	}
	return found && offset == id->length;
}
```

## src/box_relay.c
```c
#include <stdio.h>
#include <string.h>
#include <memfault/http/http_client.h>
#include <memfault/ports/zephyr/http.h>
#include <zephyr/mgmt/mcumgr/transport/smp_bt.h>
#include <zcbor_decode.h>
#include <zcbor_encode.h>
#include "box_fleet_wire.h"
#include "box_image.h"
#include "box_relay.h"

#define TRANSFER_BLOCK   384
#define RELAY_PERIOD_MS  30000
#define UPDATE_PERIOD_MS 300000

/* One encrypted session at a time. Each request owns a reference until both
 * the HTTPS and ATT operations finish; sensor polling remains independent. */
struct job {
	struct bt_conn *conn;
	int slot;
};
K_MSGQ_DEFINE(jobs, sizeof(struct job), 2, sizeof(void *));
static atomic_t scheduled;
static int64_t next_visit[2], next_check[2];
static struct job current;
static struct box_fleet_info identity;
static struct box_relay_status statuses[2] = {{.ota = "unknown"}, {.ota = "unknown"}};
static K_MUTEX_DEFINE(status_lock);
static char downloaded_version[32];
struct trial {
	char target[32];
	int64_t deadline;
};
static struct trial trials[2];

void box_relay_snapshot(int slot, struct box_relay_status *out)
{
	k_mutex_lock(&status_lock, K_FOREVER);
	*out = statuses[slot];
	k_mutex_unlock(&status_lock);
}

static void phase(const char *value)
{
	k_mutex_lock(&status_lock, K_FOREVER);
	statuses[current.slot].ota = value;
	k_mutex_unlock(&status_lock);
}

static K_SEM_DEFINE(att_done, 0, 1);
static int att_status;
static uint16_t found_handle;
static uint8_t *read_buf;
static size_t read_len, read_capacity;
static struct bt_gatt_discover_params discovery;
static struct bt_gatt_read_params read_params;
static struct bt_gatt_write_params write_params;

static uint8_t discovered(struct bt_conn *conn, const struct bt_gatt_attr *attr,
			  struct bt_gatt_discover_params *params)
{
	if (attr) {
		const struct bt_gatt_chrc *ch = attr->user_data;
		found_handle = ch->value_handle;
	}
	k_sem_give(&att_done);
	return BT_GATT_ITER_STOP;
}

static uint16_t characteristic(const struct bt_uuid *uuid)
{
	found_handle = 0;
	discovery = (struct bt_gatt_discover_params){.start_handle = 1,
						     .end_handle = 0xffff,
						     .type = BT_GATT_DISCOVER_CHARACTERISTIC,
						     .uuid = uuid,
						     .func = discovered};
	if (bt_gatt_discover(current.conn, &discovery) == 0) {
		k_sem_take(&att_done, K_FOREVER);
	}
	return found_handle;
}

static uint8_t on_read(struct bt_conn *conn, uint8_t err, struct bt_gatt_read_params *p,
		       const void *data, uint16_t len)
{
	if (!err && data && len <= read_capacity - read_len) {
		memcpy(read_buf + read_len, data, len);
		read_len += len;
		return BT_GATT_ITER_CONTINUE;
	}
	att_status = (err || data) ? -EIO : 0;
	k_sem_give(&att_done);
	return BT_GATT_ITER_STOP;
}

static int read_value(uint16_t handle, void *buf, size_t capacity)
{
	read_params = (struct bt_gatt_read_params){
		.handle_count = 1, .single.handle = handle, .func = on_read};
	read_buf = buf;
	read_len = 0;
	read_capacity = capacity;
	int rc = bt_gatt_read(current.conn, &read_params);
	if (rc) {
		return rc;
	}
	k_sem_take(&att_done, K_FOREVER);
	return att_status ? att_status : (int)read_len;
}

static void on_written(struct bt_conn *conn, uint8_t err, struct bt_gatt_write_params *p)
{
	att_status = err ? -EIO : 0;
	k_sem_give(&att_done);
}

static int write_value(uint16_t handle, const void *data, size_t size)
{
	write_params = (struct bt_gatt_write_params){
		.handle = handle, .data = data, .length = size, .func = on_written};
	int rc = bt_gatt_write(current.conn, &write_params);
	if (rc) {
		return rc;
	}
	k_sem_take(&att_done, K_FOREVER);
	return att_status;
}

static void forward_chunks(void)
{
	uint16_t h = characteristic(DS_FLEET_CHUNK);
	sMemfaultHttpContext http = {.sock_fd = -1};
	for (int i = 0; h && i < 32; i++) {
		uint8_t chunk[4 + DS_CHUNK_MAX];
		int n = read_value(h, chunk, sizeof(chunk));
		if (n <= 4 || (http.sock_fd < 0 && memfault_zephyr_port_http_open_socket(&http)) ||
		    memfault_zephyr_port_http_post_chunk(&http, chunk + 4, n - 4) ||
		    write_value(h, chunk, 4)) {
			break;
		}
	}
	memfault_zephyr_port_http_close_socket(&http);
}

/* MCUmgr stays the only writer of each box's upgrade slot. It serves the
 * Nordic phone application and this BLE central with the same protocol. */
struct channel {
	struct bt_gatt_subscribe_params sub;
	struct k_sem joined;
	atomic_t subscribed;
	uint16_t handle;
};
static struct channel channels[2];
static struct channel *channel;
static K_SEM_DEFINE(smp_done, 0, 1);
static struct k_spinlock rx_lock;
static uint8_t response[768], response_id, sequence;
static uint16_t response_group;
static uint8_t response_op;
static size_t received, expected;
static bool awaiting;
static uint8_t command[TRANSFER_BLOCK + 80];
static uint8_t block[TRANSFER_BLOCK];
static size_t offset, image_size, used;
static struct box_image_identity signed_role;

static uint8_t notified(struct bt_conn *conn, struct bt_gatt_subscribe_params *sub,
			const void *data, uint16_t len)
{
	struct channel *ch = CONTAINER_OF(sub, struct channel, sub);
	k_spinlock_key_t key = k_spin_lock(&rx_lock);
	bool signal = false;
	if (!data) {
		atomic_clear(&ch->subscribed);
		if (ch == channel && awaiting) {
			awaiting = false;
			received = 0;
			signal = true;
		}
	} else if (ch == channel && awaiting) {
		const uint8_t *p = data;
		if (received == 0) {
			if (len < 8 || p[0] != response_op ||
			    sys_get_be16(p + 4) != response_group || p[6] != sequence ||
			    p[7] != response_id) {
				goto done;
			}
			expected = 8 + sys_get_be16(p + 2);
		}
		if (expected > sizeof(response) || len > expected - received) {
			awaiting = false;
			received = 0;
			signal = true;
		} else {
			memcpy(response + received, data, len);
			received += len;
			if (received == expected) {
				awaiting = false;
				signal = true;
			}
		}
	}
done:
	k_spin_unlock(&rx_lock, key);
	if (signal) {
		k_sem_give(&smp_done);
	}
	return BT_GATT_ITER_CONTINUE;
}

static void subscribed(struct bt_conn *conn, uint8_t err, struct bt_gatt_subscribe_params *sub)
{
	struct channel *ch = CONTAINER_OF(sub, struct channel, sub);
	atomic_set(&ch->subscribed, !err);
	k_sem_give(&ch->joined);
}

static bool open_image_channel(void)
{
	struct channel *ch = &channels[current.slot];
	if (!atomic_get(&ch->subscribed)) {
		ch->handle = characteristic(SMP_BT_CHR_UUID);
		if (!ch->handle) {
			return false;
		}
		/* smp_bt.c defines the CCC immediately following the value. */
		ch->sub = (struct bt_gatt_subscribe_params){.notify = notified,
							    .subscribe = subscribed,
							    .value_handle = ch->handle,
							    .ccc_handle = ch->handle + 1,
							    .value = BT_GATT_CCC_NOTIFY};
		atomic_set_bit(ch->sub.flags, BT_GATT_SUBSCRIBE_FLAG_VOLATILE);
		k_sem_reset(&ch->joined);
		if (bt_gatt_subscribe(current.conn, &ch->sub)) {
			return false;
		}
		k_sem_take(&ch->joined, K_FOREVER);
	}
	return atomic_get(&ch->subscribed);
}

static bool transact(uint8_t op, uint16_t group, uint8_t id, size_t body_size)
{
	uint8_t *p = command;
	p[0] = op;
	p[1] = 0;
	sys_put_be16(body_size, p + 2);
	sys_put_be16(group, p + 4);
	p[7] = id;
	k_spinlock_key_t key = k_spin_lock(&rx_lock);
	channel = &channels[current.slot];
	p[6] = ++sequence;
	response_id = id;
	response_group = group;
	response_op = op + 1;
	received = expected = 0;
	k_sem_reset(&smp_done);
	awaiting = true;
	k_spin_unlock(&rx_lock, key);
	size_t n = body_size + 8;
	bool ok = true;
	while (n) {
		size_t len = MIN(n, bt_gatt_get_mtu(current.conn) - 3U);
		int rc = bt_gatt_write_without_response(current.conn, channel->handle, p, len,
							false);
		if (rc) {
			ok = false;
			break;
		}
		n -= len;
		p += len;
	}
	if (ok) {
		ok = k_sem_take(&smp_done, K_SECONDS(60)) == 0;
	}
	key = k_spin_lock(&rx_lock);
	awaiting = false;
	ok = ok && received >= 8 && received == expected;
	k_spin_unlock(&rx_lock, key);
	return ok;
}

static bool string_is(struct zcbor_string *s, const char *literal)
{
	return s->len == strlen(literal) && !memcmp(s->value, literal, s->len);
}

static bool response_number(const char *name, size_t wanted)
{
	ZCBOR_STATE_D(d, 4, response + 8, received - 8, 1, 0);
	uint32_t num;
	return zcbor_unordered_map_start_decode(d) && zcbor_search_key_tstr_term(d, name, 16) &&
	       zcbor_uint32_decode(d, &num) && num == wanted;
}

static bool send_block(size_t len)
{
	if (!box_image_observe(&signed_role, block, len, offset, image_size)) {
		return false;
	}
	if (offset == 0) {
		snprintf(downloaded_version, sizeof(downloaded_version), "%u.%u.%u+%u", block[20],
			 block[21], (unsigned)sys_get_le16(block + 22),
			 (unsigned)sys_get_le32(block + 24));
	}
	ZCBOR_STATE_E(e, 4, command + 8, sizeof(command) - 8, 1);
	if (!zcbor_map_start_encode(e, 4) || !zcbor_tstr_put_lit(e, "off") ||
	    !zcbor_uint32_put(e, offset) || !zcbor_tstr_put_lit(e, "data") ||
	    !zcbor_bstr_encode_ptr(e, block, len)) {
		return false;
	}
	if (!offset && (!zcbor_tstr_put_lit(e, "len") || !zcbor_uint32_put(e, image_size) ||
			!zcbor_tstr_put_lit(e, "upgrade") || !zcbor_bool_put(e, true))) {
		return false;
	}
	if (!zcbor_map_end_encode(e, 4) || !transact(2, 1, 1, e->payload - command - 8) ||
	    !response_number("off", offset + len)) {
		return false;
	}
	offset += len;
	return true;
}

static bool begin_update(const sMemfaultOtaInfo *info, void *ctx)
{
	phase("transferring");
	offset = used = 0;
	image_size = info->size;
	return image_size >= 32 && image_size < 896U * 1024 && open_image_channel();
}

static bool image_bytes(void *buf, size_t len, void *ctx)
{
	if (len > image_size - offset - used) {
		return false;
	}
	uint8_t *p = buf;
	while (len) {
		size_t n = MIN(len, sizeof(block) - used);
		memcpy(block + used, p, n);
		used += n;
		p += n;
		len -= n;
		if (used == sizeof(block)) {
			if (!send_block(used)) {
				return false;
			}
			used = 0;
		}
	}
	return true;
}

static bool read_image_state(uint8_t hash[32], bool require_pending)
{
	ZCBOR_STATE_D(d, 8, response + 8, received - 8, 1, 0);
	struct zcbor_string key;
	if (!zcbor_map_start_decode(d) || !zcbor_tstr_decode(d, &key) ||
	    !string_is(&key, "images") || !zcbor_list_start_decode(d)) {
		return false;
	}
	while (!zcbor_array_at_end(d)) {
		uint32_t slot = UINT32_MAX;
		bool pending = false;
		struct zcbor_string digest = {0};
		if (!zcbor_map_start_decode(d)) {
			return false;
		}
		while (!zcbor_array_at_end(d)) {
			if (!zcbor_tstr_decode(d, &key)) {
				return false;
			}
			bool valid;
			if (string_is(&key, "slot")) {
				valid = zcbor_uint32_decode(d, &slot);
			} else if (string_is(&key, "pending")) {
				valid = zcbor_bool_decode(d, &pending);
			} else if (string_is(&key, "hash")) {
				valid = zcbor_bstr_decode(d, &digest);
			} else {
				valid = zcbor_any_skip(d, NULL);
			}
			if (!valid) {
				return false;
			}
		}
		if (!zcbor_map_end_decode(d)) {
			return false;
		}
		if (slot == 1 && digest.len == 32) {
			if (require_pending) {
				return pending && !memcmp(hash, digest.value, 32);
			}
			memcpy(hash, digest.value, 32);
			return true;
		}
	}
	return false;
}

static bool finish_update(void *ctx)
{
	uint8_t hash[32];
	if ((used && !send_block(used)) || offset != image_size ||
	    !box_image_matches(&signed_role, identity.hardware)) {
		return false;
	}
	command[8] = 0xa0; /* empty CBOR map */
	if (!transact(0, 1, 0, 1) || !read_image_state(hash, false)) {
		return false;
	}
	ZCBOR_STATE_E(e, 4, command + 8, sizeof(command) - 8, 1);
	if (!zcbor_map_start_encode(e, 2) || !zcbor_tstr_put_lit(e, "hash") ||
	    !zcbor_bstr_encode_ptr(e, hash, 32) || !zcbor_tstr_put_lit(e, "confirm") ||
	    !zcbor_bool_put(e, false) || !zcbor_map_end_encode(e, 2) ||
	    !transact(2, 1, 0, e->payload - command - 8) || !read_image_state(hash, true)) {
		return false;
	}
	command[8] = 0xa0;
	/* A board can reboot before delivering its reset response. Re-read its
	 * identity and MCUboot confirmation rather than concluding success here. */
	struct trial *trial = &trials[current.slot];
	strcpy(trial->target, downloaded_version);
	trial->deadline = k_uptime_get() + 180000;
	phase("restarting");
	return transact(2, 0, 5, 1);
}

/* The SDK calls this synchronously from the requesting thread. Only the box
 * worker substitutes its current peer; gateway heartbeat/FOTA use G's ID. */
static k_tid_t relay_tid;
static void http_identity(sMemfaultDeviceInfo *info)
{
	if (k_current_get() == relay_tid) {
		*info = (sMemfaultDeviceInfo){.device_serial = identity.serial,
					      .hardware_version = identity.hardware,
					      .software_type = identity.software,
					      .software_version = identity.version};
	} else {
		memfault_platform_get_device_info(info);
	}
}

static bool valid_field(const char *s, size_t n)
{
	size_t len = strnlen(s, n);
	return len && len < n && strcmp(s, "Unknown") &&
	       strspn(s, "abcdefghijklmnopqrstuvwxyzABCDEFGHIJKLMNOPQRSTUVWXYZ0123456789.-_+") ==
		       len;
}

static void run_job(void)
{
	uint16_t h = characteristic(DS_FLEET_INFO);
	const char *role = current.slot ? "dryspool-box-b" : "dryspool-box-a";
	if (!h || read_value(h, &identity, sizeof(identity)) != sizeof(identity) ||
	    !valid_field(identity.serial, sizeof(identity.serial)) ||
	    !valid_field(identity.version, sizeof(identity.version)) ||
	    strncmp(identity.hardware, role, sizeof(identity.hardware)) ||
	    strncmp(identity.software, role, sizeof(identity.software))) {
		return;
	}
	struct box_relay_status *status = &statuses[current.slot];
	k_mutex_lock(&status_lock, K_FOREVER);
	strcpy(status->serial, identity.serial);
	strcpy(status->firmware, identity.version);
	if (!strcmp(status->ota, "unknown")) {
		status->ota = "idle";
	}
	k_mutex_unlock(&status_lock);
	struct trial *trial = &trials[current.slot];
	if (trial->target[0]) {
		if (identity.confirmed && !strcmp(identity.version, trial->target)) {
			phase("idle");
			trial->target[0] = 0;
			next_check[current.slot] = k_uptime_get() + UPDATE_PERIOD_MS;
		} else if (k_uptime_get() > trial->deadline) {
			phase("failed");
			trial->target[0] = 0;
			next_check[current.slot] = k_uptime_get() + UPDATE_PERIOD_MS;
		}
	}
	forward_chunks();
	if (!trial->target[0] && k_uptime_get() >= next_check[current.slot]) {
		phase("checking");
		uint8_t buf[512];
		const sMemfaultOtaUpdateHandler handler = {.buf = buf,
							   .buf_len = sizeof(buf),
							   .handle_update_available = begin_update,
							   .handle_data = image_bytes,
							   .handle_download_complete =
								   finish_update};
		int rc = memfault_zephyr_port_ota_update(&handler);
		if (!trial->target[0]) {
			phase(rc < 0 ? "failed" : "idle");
		}
		printk("Box %c release check (%s): %d\n", 'A' + current.slot, identity.version, rc);
		next_check[current.slot] =
			k_uptime_get() + (rc < 0 ? RELAY_PERIOD_MS : UPDATE_PERIOD_MS);
	}
}

static void relay(void *a, void *b, void *c)
{
	relay_tid = k_current_get();
	for (int i = 0; i < ARRAY_SIZE(channels); i++) {
		k_sem_init(&channels[i].joined, 0, 1);
	}
	g_mflt_http_client_config.get_device_info = http_identity;
	for (;;) {
		k_msgq_get(&jobs, &current, K_FOREVER);
		run_job();
		bt_conn_unref(current.conn);
		atomic_clear_bit(&scheduled, current.slot);
	}
}
K_THREAD_DEFINE(box_uplink, 5632, relay, NULL, NULL, NULL, 9, 0, 0);

void box_relay_connected(int slot, struct bt_conn *conn)
{
	int64_t now = k_uptime_get();
	if (now < next_visit[slot] || atomic_test_and_set_bit(&scheduled, slot)) {
		return;
	}
	struct job j = {.slot = slot, .conn = bt_conn_ref(conn)};
	if (k_msgq_put(&jobs, &j, K_NO_WAIT)) {
		bt_conn_unref(j.conn);
		atomic_clear_bit(&scheduled, slot);
	} else {
		next_visit[slot] = now + RELAY_PERIOD_MS;
	}
}
```

## src/box_relay.h
```c
#pragma once
#include <zephyr/bluetooth/conn.h>
/* Called by the BLE central once a paired box link is encrypted. */
void box_relay_connected(int slot, struct bt_conn *conn);

struct box_relay_status {
	char firmware[32];
	char serial[33];
	const char *ota;
};
void box_relay_snapshot(int slot, struct box_relay_status *out);
```

## src/bridge.h
```c
#pragma once
#include <stdint.h>
#include <stddef.h>
int gateway_snapshot(int slot, char *out, size_t size);
int gateway_command(int slot, const char *mode, uint32_t *id);
int gateway_cloud_command(int slot, const char *mode, uint32_t id, int64_t remaining_ms);
int gateway_http_start(void);
```

## src/cloud_shadow.c
```c
#include <errno.h>
#include <stdio.h>
#include <string.h>
#include <cJSON.h>
#include <date_time.h>
#include <net/nrf_cloud_coap.h>
#include <zephyr/kernel.h>
#include <zephyr/logging/log.h>
#include <zephyr/net/net_if.h>
#include <zephyr/app_version.h>
#include "bridge.h"
#include "box_relay.h"

LOG_MODULE_REGISTER(gateway_shadow, LOG_LEVEL_INF);

/* Buffered only in the cloud thread. A blocked/reconnecting DTLS session
 * must not stop the LAN server, the BLE poller or local humidity control. */
static char incoming[4097];
static char report[1200];

static int get_config(bool delta, cJSON **root)
{
	size_t n = sizeof(incoming) - 1;
	*root = NULL;
	int rc = nrf_cloud_coap_shadow_get(incoming, &n, delta, COAP_CONTENT_FORMAT_APP_JSON);
	if (rc || !n) {
		return rc;
	}
	incoming[n] = 0;
	*root = cJSON_Parse(incoming);
	return *root ? 0 : -EBADMSG;
}

static int pending_slots(void)
{
	cJSON *root;
	int rc = get_config(true, &root);
	if (rc) {
		return rc > 0 ? -EPROTO : rc;
	}
	const cJSON *config = cJSON_GetObjectItemCaseSensitive(root, "config");
	int mask = (cJSON_GetObjectItemCaseSensitive(config, "A") ? BIT(0) : 0) |
		   (cJSON_GetObjectItemCaseSensitive(config, "B") ? BIT(1) : 0);
	cJSON_Delete(root);
	return mask;
}

static bool whole_number(const cJSON *value, double limit)
{
	return cJSON_IsNumber(value) && value->valuedouble >= 1 && value->valuedouble <= limit &&
	       (double)(uint32_t)value->valuedouble == value->valuedouble;
}

static int sync_boxes(void)
{
	/* A delta may omit the mode if only the request ID changed. Get the
	 * full desired tuple for slots with unacknowledged changes. */
	int mask = pending_slots();
	if (mask < 0) {
		return mask;
	}
	cJSON *root = NULL;
	if (mask) {
		int rc = get_config(false, &root);
		if (rc) {
			return rc;
		}
	}
	const cJSON *config = cJSON_GetObjectItemCaseSensitive(root, "config");
	char ack[2][90] = {0};
	for (int i = 0; i < 2; ++i) {
		if (!(mask & BIT(i))) {
			continue;
		}
		const cJSON *cmd = cJSON_GetObjectItemCaseSensitive(config, i ? "B" : "A");
		const cJSON *id = cJSON_GetObjectItemCaseSensitive(cmd, "request");
		const cJSON *mode = cJSON_GetObjectItemCaseSensitive(cmd, "mode");
		const cJSON *expires = cJSON_GetObjectItemCaseSensitive(cmd, "expires");
		int64_t now;
		if (!whole_number(id, INT32_MAX) || !whole_number(expires, UINT32_MAX) ||
		    !cJSON_IsString(mode) || date_time_now(&now)) {
			continue;
		}
		uint32_t until = (uint32_t)expires->valuedouble;
		if (gateway_cloud_command(i, mode->valuestring, id->valueint,
					  (int64_t)until * 1000 - now) == 1) {
			snprintf(ack[i], sizeof(ack[i]),
				 "\"%c\":{\"mode\":\"%s\",\"request\":%d,\"expires\":%u}", 'A' + i,
				 mode->valuestring, id->valueint, until);
		}
	}
	cJSON_Delete(root);
	char sample[2][475];
	for (int i = 0; i < 2; ++i) {
		int n = gateway_snapshot(i, sample[i], sizeof(sample[i]));
		if (n <= 0 || n >= sizeof(sample[i])) {
			return -ENOBUFS;
		}
		struct box_relay_status status;
		box_relay_snapshot(i, &status);
		/* The relay admits bounded, alphanumeric identity strings and
		 * supplies a literal phase after observing the box's state. */
		size_t left = sizeof(sample[i]) - (n - 1);
		int written = snprintf(sample[i] + n - 1, left,
				       ",\"firmware\":\"%s\",\"serial\":\"%s\",\"ota\":\"%s\"}",
				       status.firmware, status.serial, status.ota);
		if (written < 0 || written >= left) {
			return -ENOBUFS;
		}
	}
	bool any_ack = ack[0][0] || ack[1][0];
	int n = snprintf(report, sizeof(report), "{\"dryspool\":{\"A\":%s,\"B\":%s}%s%s%s%s%s}",
			 sample[0], sample[1], any_ack ? ",\"config\":{" : "", ack[0],
			 ack[0][0] && ack[1][0] ? "," : "", ack[1], any_ack ? "}" : "");
	if (n < 0 || n >= sizeof(report)) {
		return -ENOBUFS;
	}
	return nrf_cloud_coap_shadow_state_update(report);
}

static void shadow_worker(void *a, void *b, void *c)
{
	int rc;
	while ((rc = nrf_cloud_coap_init()) != 0) {
		LOG_WRN("Cloud init: %d", rc);
		k_sleep(K_SECONDS(30));
	}
	for (;;) {
		if (!net_if_ipv4_get_global_addr(net_if_get_default(), NET_ADDR_PREFERRED)) {
			k_sleep(K_SECONDS(5));
			continue;
		}
		if (!date_time_is_valid()) {
			date_time_update_async(NULL);
			k_sleep(K_SECONDS(15));
			continue;
		}
		rc = nrf_cloud_coap_connect(APP_VERSION_STRING);
		if (!rc) {
			LOG_INF("Gateway Device Shadow connected");
			while (!(rc = sync_boxes())) {
				k_sleep(K_SECONDS(5));
			}
		}
		LOG_WRN("Cloud session ended: %d; retrying", rc);
		(void)nrf_cloud_coap_disconnect();
		k_sleep(K_SECONDS(10));
	}
}

K_THREAD_DEFINE(shadow_thread, 6144, shadow_worker, NULL, NULL, NULL, 6, 0, 0);
```

## src/gateway.c
```c
#include <stdio.h>
#include <string.h>
#include <zephyr/random/random.h>
#include "protocol.h"
#include "bridge.h"
#include "box_relay.h"
#include <zephyr/dfu/mcuboot.h>
#include <zephyr/net/conn_mgr_connectivity.h>
#include <zephyr/net/dhcpv4.h>
#include <memfault/metrics/metrics.h>

struct slot {
	struct bt_conn *link; /* Owned by the gateway main loop. */
	uint16_t handle;
	struct box_sample sample;
	int64_t seen;
	uint32_t pending;
	uint8_t requested;
	bool send;
	int64_t deadline;
};
static struct slot boxes[2];
static K_MUTEX_DEFINE(lock);
static const char *const modes[] = {"auto", "on", "off"};
static const char *const names[] = {"DrySpool A", "DrySpool B"};

int gateway_snapshot(int slot, char *out, size_t size)
{
	k_mutex_lock(&lock, K_FOREVER);
	struct slot *s = &boxes[slot];
	struct box_sample b = s->sample;
	int64_t age = s->seen ? k_uptime_get() - s->seen : -1;
	bool fresh = age >= 0 && age < 10000;
	char temp[20] = "null", rh[20] = "null", grams[16] = "null";
	if (fresh && (b.flags & ENV_OK)) {
		snprintf(temp, sizeof(temp), "%.3f", (int32_t)sys_get_le32(b.temp) / 1000.0);
		snprintf(rh, sizeof(rh), "%.3f", (int32_t)sys_get_le32(b.rh) / 1000.0);
	}
	if (fresh && (b.flags & GRAMS_OK)) {
		snprintf(grams, sizeof(grams), "%d", (int32_t)sys_get_le32(b.grams));
	}
	bool valid = fresh && (b.flags & FAN_OK);
	int n = snprintf(
		out, size,
		"{\"slot\":\"%c\",\"device\":\"%s\",\"ageMs\":%lld,\"online\":%s,\"seq\":%u,"
		"\"temperature\":%s,"
		"\"humidity\":%s,\"grams\":%s,\"fan\":%s,\"mode\":\"%s\",\"request\":%u,"
		"\"control\":%s,\"pending\":%s,\"desired\":\"%s\",\"error\":%s}",
		'A' + slot, names[slot], (long long)age, fresh ? "true" : "false",
		k_uptime_get_32(), temp, rh, grams,
		valid ? ((b.flags & OUTPUT_ON) ? "true" : "false") : "null",
		valid && b.mode < ARRAY_SIZE(modes) ? modes[b.mode] : "",
		sys_get_le32(b.command_id), valid ? "true" : "false", s->pending ? "true" : "false",
		modes[s->requested], !fresh ? "\"Box offline\"" : "null");
	k_mutex_unlock(&lock);
	return n;
}

static int queue_command(int slot, const char *mode, uint32_t id, int64_t deadline)
{
	int index = 0;
	while (index < ARRAY_SIZE(modes) && strcmp(mode, modes[index])) {
		index++;
	}
	if (index == ARRAY_SIZE(modes)) {
		return -EINVAL;
	}
	struct slot *s = &boxes[slot];
	k_mutex_lock(&lock, K_FOREVER);
	int rc = -EBUSY;
	if (s->seen && k_uptime_get() - s->seen < 10000 && (s->sample.flags & FAN_OK) &&
	    !s->pending) {
		s->pending = id;
		s->requested = index;
		s->send = true;

		s->deadline = deadline;
		rc = 0;
	}
	k_mutex_unlock(&lock);
	return rc;
}

int gateway_command(int slot, const char *mode, uint32_t *id)
{
	*id = (sys_rand32_get() & INT32_MAX) | 1;
	return queue_command(slot, mode, *id, k_uptime_get() + 10000);
}

int gateway_cloud_command(int slot, const char *mode, uint32_t id, int64_t remaining_ms)
{
	/* Cloud reports the command only after the node's readback matches its id and mode. */
	k_mutex_lock(&lock, K_FOREVER);
	const struct slot *s = &boxes[slot];
	bool applied = s->seen && k_uptime_get() - s->seen < 10000 && (s->sample.flags & FAN_OK) &&
		       s->sample.mode < ARRAY_SIZE(modes) && !strcmp(modes[s->sample.mode], mode) &&
		       sys_get_le32(s->sample.command_id) == id;
	k_mutex_unlock(&lock);
	if (applied) {
		return 1;
	}
	if (remaining_ms <= 0 || remaining_ms > 60000) {
		return -ETIME;
	}
	return queue_command(slot, mode, id, k_uptime_get() + MIN(remaining_ms, 10000));
}

struct candidate {
	int slot;
	bt_addr_le_t addr;
};
K_MSGQ_DEFINE(found, sizeof(struct candidate), 8, 4);
static atomic_t occupied;
static bool name_field(struct bt_data *d, void *ctx)
{
	struct candidate *p = ctx;
	if (d->type != BT_DATA_NAME_COMPLETE) {
		return true;
	}
	for (int i = 0; i < ARRAY_SIZE(names); i++) {
		if (!atomic_test_bit(&occupied, i) && d->data_len == strlen(names[i]) &&
		    !memcmp(d->data, names[i], d->data_len)) {
			p->slot = i;
			k_msgq_put(&found, p, K_NO_WAIT);
			return false;
		}
	}
	return true;
}

static void scan_cb(const bt_addr_le_t *addr, int8_t rssi, uint8_t type, struct net_buf_simple *ad)
{
	if (type == BT_GAP_ADV_TYPE_ADV_IND) {
		struct candidate p = {.addr = *addr};
		bt_data_parse(ad, name_field, &p);
	}
}

/* Serialize client reads. The ATT callback finishes before the next request
 * reuses these parameters. The HTTP server runs independently. */
static struct bt_gatt_read_params reader;
static struct box_sample received;
static uint16_t received_handle;
static K_SEM_DEFINE(read_done, 0, 1);

static uint8_t on_read(struct bt_conn *conn, uint8_t err, struct bt_gatt_read_params *params,
		       const void *data, uint16_t len)
{
	if (!err && data && len == sizeof(received)) {
		memcpy(&received, data, len);
		received_handle = params->by_uuid.start_handle;
	}
	k_sem_give(&read_done);
	return BT_GATT_ITER_STOP;
}

static void poll_box(struct slot *s)
{
	if (bt_conn_get_security(s->link) < BT_SECURITY_L2) {
		bt_conn_set_security(s->link, BT_SECURITY_L2);
		return;
	}
	box_relay_connected(s - boxes, s->link);
	k_mutex_lock(&lock, K_FOREVER);
	if (s->pending && k_uptime_get() >= s->deadline) {
		s->send = false;

		s->pending = 0;
	}
	bool send = s->send && s->handle;
	uint8_t cmd[5] = {s->requested};
	sys_put_le32(s->pending, cmd + 1);
	k_mutex_unlock(&lock);
	if (send && !bt_gatt_write_without_response(s->link, s->handle, cmd, sizeof(cmd), false)) {
		k_mutex_lock(&lock, K_FOREVER);
		s->send = false;
		k_mutex_unlock(&lock);
	}
	received_handle = 0;
	reader = (struct bt_gatt_read_params){
		.func = on_read,
		.by_uuid = {.start_handle = 1, .end_handle = 0xffff, .uuid = DS_BOX}};
	if (bt_gatt_read(s->link, &reader)) {
		return;
	}
	k_sem_take(&read_done, K_FOREVER);
	if (!received_handle) {
		return;
	}
	k_mutex_lock(&lock, K_FOREVER);
	s->handle = received_handle;
	s->sample = received;
	if (received.flags & ENV_OK) {
		int32_t rh = (int32_t)sys_get_le32(received.rh) / 100;
		int32_t t = (int32_t)sys_get_le32(received.temp) / 100;
		if (s == boxes) {
			MEMFAULT_METRIC_SET_UNSIGNED(box_a_rh, rh);
			MEMFAULT_METRIC_SET_SIGNED(box_a_temp, t);
		} else {
			MEMFAULT_METRIC_SET_UNSIGNED(box_b_rh, rh);
			MEMFAULT_METRIC_SET_SIGNED(box_b_temp, t);
		}
	}
	if (received.flags & GRAMS_OK) {
		uint32_t g = sys_get_le32(received.grams);
		if (s == boxes) {
			MEMFAULT_METRIC_SET_UNSIGNED(box_a_grams, g);
		} else {
			MEMFAULT_METRIC_SET_UNSIGNED(box_b_grams, g);
		}
	}
	s->seen = k_uptime_get();
	if (s->pending && (received.flags & FAN_OK) && received.mode == s->requested &&
	    sys_get_le32(received.command_id) == s->pending) {
		s->pending = 0;
	}
	k_mutex_unlock(&lock);
}

int main(void)
{
	int rc = radio_start();
	if (rc) {
		printk("BLE startup failed: %d\n", rc);
		return rc;
	}
	conn_mgr_all_if_up(true);
	net_dhcpv4_start(net_if_get_default());
	conn_mgr_all_if_connect(true);
	rc = gateway_http_start();
	if (rc) {
		printk("HTTP startup failed: %d\n", rc);
		return rc;
	}
	bool scanning = false;
	for (;;) {
		bool connecting = false;
		for (int i = 0; i < ARRAY_SIZE(boxes); i++) {
			struct slot *s = &boxes[i];
			if (!s->link) {
				continue;
			}
			struct bt_conn_info info;
			if (bt_conn_get_info(s->link, &info) ||
			    info.state == BT_CONN_STATE_DISCONNECTED) {
				bt_conn_unref(s->link);
				k_mutex_lock(&lock, K_FOREVER);
				*s = (struct slot){0};
				k_mutex_unlock(&lock);
				atomic_clear_bit(&occupied, i);
			} else if (info.state == BT_CONN_STATE_CONNECTED) {
				poll_box(s);
			} else {
				connecting = true;
			}
		}
		if (!connecting && atomic_get(&occupied) != 3 && !scanning) {
			scanning = !bt_le_scan_start(BT_LE_SCAN_PASSIVE, scan_cb);
		}
		struct candidate p;
		if (scanning && !k_msgq_get(&found, &p, K_NO_WAIT) && !boxes[p.slot].link) {
			bt_le_scan_stop();
			scanning = false;
			k_msgq_purge(&found);
			rc = bt_conn_le_create(&p.addr, BT_CONN_LE_CREATE_CONN,
					       BT_LE_CONN_PARAM_DEFAULT, &boxes[p.slot].link);
			if (!rc) {
				atomic_set_bit(&occupied, p.slot);
			}
		}
		if (scanning || atomic_get(&occupied)) {
			if (!boot_is_img_confirmed()) {
				boot_write_img_confirmed();
			}
		}
		k_sleep(K_MSEC(500));
	}
}
```

## src/node.c
```c
#include "protocol.h"
#include "readings.h"
#include "node_fleet.h"

static ssize_t read_box(struct bt_conn *conn, const struct bt_gatt_attr *attr, void *buf,
			uint16_t len, uint16_t offset)
{
	struct dryspool_sample s;
	if (!dryspool_read_latest(&s) || k_uptime_get() - s.uptime_ms > 10000) {
		return BT_GATT_ERR(BT_ATT_ERR_UNLIKELY);
	}
	struct box_sample wire = {.mode = s.fan_request.mode};
	wire.flags = (s.env_valid ? ENV_OK : 0) | (s.grams_valid ? GRAMS_OK : 0) |
		     (s.fan_valid ? FAN_OK : 0) | (s.fan_on ? OUTPUT_ON : 0);
	sys_put_le32(s.temperature_mc, wire.temp);
	sys_put_le32(s.humidity_mpct, wire.rh);
	sys_put_le32(s.filament_g, wire.grams);
	sys_put_le32(s.fan_request.id, wire.command_id);
	return bt_gatt_attr_read(conn, attr, buf, len, offset, &wire, sizeof(wire));
}

static ssize_t write_box(struct bt_conn *conn, const struct bt_gatt_attr *attr, const void *buf,
			 uint16_t len, uint16_t offset, uint8_t flags)
{
	const uint8_t *p = buf;
	if (offset || len != 5 || p[0] > FAN_OFF) {
		return BT_GATT_ERR(BT_ATT_ERR_VALUE_NOT_ALLOWED);
	}
	dryspool_set_fan_request((struct fan_request){p[0], (int32_t)sys_get_le32(p + 1)});
	return len;
}
BT_GATT_SERVICE_DEFINE(box_svc, BT_GATT_PRIMARY_SERVICE(DS_SERVICE),
		       BT_GATT_CHARACTERISTIC(DS_BOX,
					      BT_GATT_CHRC_READ | BT_GATT_CHRC_WRITE_WITHOUT_RESP,
					      BT_GATT_PERM_READ_ENCRYPT |
						      BT_GATT_PERM_WRITE_ENCRYPT,
					      read_box, write_box, NULL));

static void start_node(void *a, void *b, void *c)
{
	int rc = radio_start();
	if (rc) {
		printk("BLE startup failed: %d\n", rc);
	}
	box_check_trial(rc == 0);
}
K_THREAD_DEFINE(node_radio, 3072, start_node, NULL, NULL, NULL, 7, 0, 0);
```

## src/node_fleet.c
```c
#include <string.h>
#include <memfault/core/data_packetizer.h>
#include <memfault/core/platform/device_info.h>
#include <memfault/metrics/metrics.h>
#include <zephyr/dfu/mcuboot.h>
#include <zephyr/sys/reboot.h>
#include "box_fleet_wire.h"
#include "node_fleet.h"
#include "readings.h"

static bool fresh_sample(struct dryspool_sample *s)
{
	return dryspool_read_latest(s) && k_uptime_get() - s->uptime_ms < 10000;
}

void memfault_metrics_heartbeat_collect_data(void)
{
	struct dryspool_sample s;
	if (!fresh_sample(&s)) {
		return;
	}
	if (s.env_valid) {
		MEMFAULT_METRIC_SET_SIGNED(dryspool_temperature_c, s.temperature_mc / 100);
		MEMFAULT_METRIC_SET_UNSIGNED(dryspool_humidity_pct, s.humidity_mpct / 100);
	}
	if (s.grams_valid) {
		MEMFAULT_METRIC_SET_UNSIGNED(dryspool_filament_g, s.filament_g);
	}
	if (s.fan_valid) {
		MEMFAULT_METRIC_SET_UNSIGNED(dryspool_dehumidifier_on, s.fan_on);
	}
}

void box_check_trial(bool radio_ok)
{
	if (boot_is_img_confirmed()) {
		return;
	}
	for (int i = 0; radio_ok && i < 60; ++i) {
		struct dryspool_sample s;
		if (fresh_sample(&s) && s.env_valid && s.raw_valid && s.fan_valid &&
		    boot_write_img_confirmed() == 0) {
			return;
		}
		k_sleep(K_SECONDS(1));
	}
	/* Reset a trial that failed its local health check so MCUboot can revert. */
	sys_reboot(SYS_REBOOT_COLD);
}

static ssize_t read_info(struct bt_conn *conn, const struct bt_gatt_attr *attr, void *buf,
			 uint16_t len, uint16_t offset)
{
	sMemfaultDeviceInfo identity;
	memfault_platform_get_device_info(&identity);
	struct box_fleet_info info = {0};
	if (!identity.device_serial || !identity.hardware_version || !identity.software_type ||
	    !identity.software_version || strlen(identity.device_serial) >= sizeof(info.serial) ||
	    strlen(identity.hardware_version) >= sizeof(info.hardware) ||
	    strlen(identity.software_type) >= sizeof(info.software) ||
	    strlen(identity.software_version) >= sizeof(info.version)) {
		return BT_GATT_ERR(BT_ATT_ERR_UNLIKELY);
	}
	strcpy(info.serial, identity.device_serial);
	strcpy(info.hardware, identity.hardware_version);
	strcpy(info.software, identity.software_type);
	strcpy(info.version, identity.software_version);
	info.confirmed = boot_is_img_confirmed();
	return bt_gatt_attr_read(conn, attr, buf, len, offset, &info, sizeof(info));
}

/* Keep the chunk in RAM until G has received a 2xx from Memfault. Reads may
 * be retried after a failed HTTPS POST or a dropped Bluetooth connection. */
static K_MUTEX_DEFINE(chunk_lock);
static uint8_t pending[4 + DS_CHUNK_MAX];
static uint32_t sequence;
static size_t size;

static ssize_t read_chunk(struct bt_conn *conn, const struct bt_gatt_attr *attr, void *buf,
			  uint16_t len, uint16_t offset)
{
	k_mutex_lock(&chunk_lock, K_FOREVER);
	if (size == 0 && offset == 0) {
		size_t n = DS_CHUNK_MAX;
		if (memfault_packetizer_get_chunk(pending + 4, &n)) {
			sys_put_le32(++sequence, pending);
			size = n + 4;
		}
	}
	ssize_t n = bt_gatt_attr_read(conn, attr, buf, len, offset, pending, size);
	k_mutex_unlock(&chunk_lock);
	return n;
}

static ssize_t ack_chunk(struct bt_conn *conn, const struct bt_gatt_attr *attr, const void *buf,
			 uint16_t len, uint16_t offset, uint8_t flags)
{
	if (offset || len != 4) {
		return BT_GATT_ERR(BT_ATT_ERR_INVALID_ATTRIBUTE_LEN);
	}
	k_mutex_lock(&chunk_lock, K_FOREVER);
	if (sys_get_le32(buf) == sequence) {
		size = 0;
	}
	k_mutex_unlock(&chunk_lock);
	return len;
}

BT_GATT_SERVICE_DEFINE(box_fleet, BT_GATT_PRIMARY_SERVICE(DS_FLEET_SVC),
		       BT_GATT_CHARACTERISTIC(DS_FLEET_INFO, BT_GATT_CHRC_READ,
					      BT_GATT_PERM_READ_ENCRYPT, read_info, NULL, NULL),
		       BT_GATT_CHARACTERISTIC(DS_FLEET_CHUNK,
					      BT_GATT_CHRC_READ | BT_GATT_CHRC_WRITE,
					      BT_GATT_PERM_READ_ENCRYPT |
						      BT_GATT_PERM_WRITE_ENCRYPT,
					      read_chunk, ack_chunk, NULL));
```

## src/node_fleet.h
```c
#pragma once
#include <stdbool.h>
void box_check_trial(bool radio_ok);
```

## src/protocol.h
```c
#pragma once
#include <zephyr/bluetooth/bluetooth.h>
#include <zephyr/bluetooth/conn.h>
#include <zephyr/bluetooth/gatt.h>
#include <zephyr/kernel.h>
#include <zephyr/sys/byteorder.h>

/* Keep box packets within the default ATT payload. All integers little endian. */
enum {
	ENV_OK = 1,
	GRAMS_OK = 2,
	FAN_OK = 4,
	OUTPUT_ON = 8
};
struct box_sample {
	uint8_t flags, mode;
	uint8_t temp[4], rh[4], grams[4], command_id[4];
};
#define DS_UUID(n)                                                                                 \
	BT_UUID_DECLARE_128(                                                                       \
		BT_UUID_128_ENCODE(0x7ba10000 + (n), 0x51a3, 0x4386, 0x9168, 0xca23e2270001))
#define DS_SERVICE DS_UUID(0)
#define DS_BOX     DS_UUID(1)
int radio_start(void);
```

## src/radio.c
```c
#include <zephyr/drivers/gpio.h>
#include <zephyr/settings/settings.h>
#include "protocol.h"

static const struct gpio_dt_spec button = GPIO_DT_SPEC_GET(DT_ALIAS(sw0), gpios);

static enum bt_security_err accept_pair(struct bt_conn *conn,
					const struct bt_conn_pairing_feat *feat)
{
	return gpio_pin_get_dt(&button) == 1 ? BT_SECURITY_ERR_SUCCESS
					     : BT_SECURITY_ERR_PAIR_NOT_ALLOWED;
}

static struct bt_conn_auth_cb auth = {.pairing_accept = accept_pair};
#ifdef CONFIG_DRYSPOOL_NODE
#include <zephyr/mgmt/mcumgr/transport/smp_bt.h>
static const struct bt_data sd[] = {BT_DATA_BYTES(BT_DATA_UUID128_ALL, SMP_BT_SVC_UUID_VAL)};
static const struct bt_data adv[] = {
	BT_DATA_BYTES(BT_DATA_FLAGS, BT_LE_AD_GENERAL | BT_LE_AD_NO_BREDR),
	BT_DATA(BT_DATA_NAME_COMPLETE, CONFIG_BT_DEVICE_NAME, sizeof(CONFIG_BT_DEVICE_NAME) - 1),
};

static void advertise(struct k_work *work)
{
	int rc = bt_le_adv_start(BT_LE_ADV_CONN_FAST_2, adv, ARRAY_SIZE(adv), sd, ARRAY_SIZE(sd));
	if (rc && rc != -EALREADY && rc != -ENOMEM) {
		printk("Advertising failed: %d\n", rc);
	}
}
static K_WORK_DEFINE(adv_work, advertise);
static void recycled(void)
{
	k_work_submit(&adv_work);
}
/* Keep advertising after the first connection so a phone can do DFU
 * while the gateway remains connected. */
static void connected(struct bt_conn *conn, uint8_t err)
{
	k_work_submit(&adv_work);
}
BT_CONN_CB_DEFINE(radio_cb) = {.connected = connected, .recycled = recycled};

#endif
int radio_start(void)
{
	if (!gpio_is_ready_dt(&button)) {
		return -ENODEV;
	}
	int rc = gpio_pin_configure_dt(&button, GPIO_INPUT);
	if (!rc) {
		rc = bt_conn_auth_cb_register(&auth);
	}
	if (!rc) {
		rc = bt_enable(NULL);
	}
	if (!rc) {
		rc = settings_load();
	}
#ifdef CONFIG_DRYSPOOL_NODE
	if (!rc) {
		k_work_submit(&adv_work);
	}
#endif
	return rc;
}
```
